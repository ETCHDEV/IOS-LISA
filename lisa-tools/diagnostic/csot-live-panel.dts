			qcom,mdss_dsi_k9d_42_0d_0b_dsc_cmd {
				qcom,mdss-dsi-panel-name = "xiaomi 42 0d 0b cmd mode dsc dsi panel";
				qcom,mdss-dsi-panel-type = "dsi_cmd_mode";
				qcom,mdss-dsi-virtual-channel-id = <0x00>;
				qcom,mdss-dsi-stream = <0x00>;
				qcom,mdss-dsi-bpp = <0x1e>;
				qcom,mdss-dsi-color-order = "rgb_swap_rgb";
				qcom,mdss-dsi-underflow-color = <0xff>;
				qcom,mdss-dsi-border-color = <0x00>;
				qcom,dsi-ctrl-num = <0x00>;
				qcom,dsi-phy-num = <0x00>;
				qcom,mdss-dsi-traffic-mode = "burst_mode";
				qcom,mdss-dsi-lane-map = "lane_map_0123";
				qcom,mdss-dsi-bllp-eof-power-mode;
				qcom,mdss-dsi-bllp-power-mode;
				qcom,mdss-dsi-lane-0-state;
				qcom,mdss-dsi-lane-1-state;
				qcom,mdss-dsi-lane-2-state;
				qcom,mdss-dsi-lane-3-state;
				qcom,mdss-dsi-dma-trigger = "trigger_sw";
				qcom,mdss-dsi-mdp-trigger = "none";
				qcom,mdss-dsi-reset-sequence = <0x01 0x06 0x00 0x01 0x01 0x0b>;
				qcom,mdss-pan-physical-width-dimension = <0x46>;
				qcom,mdss-pan-physical-height-dimension = <0x9a>;
				qcom,mdss-dsi-te-pin-select = <0x01>;
				qcom,mdss-dsi-wr-mem-start = <0x2c>;
				qcom,mdss-dsi-wr-mem-continue = <0x3c>;
				qcom,mdss-dsi-te-dcs-command = <0x01>;
				qcom,mdss-dsi-te-check-enable;
				qcom,mdss-dsi-te-using-te-pin;
				qcom,mdss-dsi-tx-eot-append;
				qcom,mdss-dsi-lp11-init;
				qcom,mdss-dsi-bl-inverted-dbv;
				qcom,bl-dsc-cmd-state = "dsi_lp_mode";
				qcom,bl-update-flag = "delay_until_first_frame";
				qcom,mdss-dsi-panel-hdr-enabled;
				qcom,mdss-dsi-panel-hdr-color-primaries = <0x38a4 0x3c8c 0x7d00 0x4268 0x3c8c 0x7530 0x1f40 0xbb8>;
				mi,panel-id = "\0K9D\0B\r";
				mi,hbm-51-ctl-flag;
				mi,hbm-off-51-index = <0x01>;
				mi,hbm-on-51-index = <0x01>;
				mi,hbm-bl-min-level = <0x01>;
				mi,hbm-bl-max-level = <0x7ff>;
				mi,panel-on-dimming-delay = <0x78>;
				mi,panel-status-check-interval = <0x7d0>;
				mi,max-brightness-clone = <0xfff>;
				mi,fp-display-on-optimize-flag;
				mi,thermal-dimming-flag;
				mi,esd-err-irq-gpio = <0x3c 0x03 0x2004>;
				qcom,esd-check-enabled;
				qcom,esd-aod-check-enabled;
				qcom,mdss-dsi-panel-status-check-mode = "reg_read";
				qcom,mdss-dsi-panel-status-offset-command = [39 01 00 00 00 00 03 ff 5a 80 15 01 00 00 00 00 02 65 37];
				qcom,mdss-dsi-panel-status-command = <0x6010000 0x1f5 0x6010000 0x10a 0x6010000 0x1aa>;
				qcom,mdss-dsi-panel-status-read-length = <0x03 0x01 0x01>;
				qcom,mdss-dsi-panel-status-value = <0x00 0x00 0x00 0x9c 0x53 0x00 0x00 0x00 0xdc 0x93>;
				qcom,mdss-dsi-panel-status-command-state = "dsi_lp_mode";
				qcom,mdss-dsi-panel-status-offset-command-state = "dsi_lp_mode";
				qcom,dsi-select-clocks = "mux_byte_clk0\0mux_pixel_clk0";
				qcom,mdss-dsi-clk-strength = <0xff>;
				qcom,panel-supply-entries = <0x59c>;
				qcom,mdss-dsi-bl-pmic-control-type = "bl_ctrl_dcs";
				qcom,mdss-dsi-bl-min-level = <0x08>;
				qcom,mdss-dsi-factory-bl-max-level = <0x7ff>;
				qcom,mdss-factory-brightness-max-level = <0x7ff>;
				qcom,mdss-dsi-bl-max-level = <0xfff>;
				qcom,mdss-brightness-init-level = <0x133>;
				qcom,mdss-brightness-max-level = <0xfff>;
				qcom,platform-te-gpio = <0x3c 0x50 0x00>;
				qcom,platform-reset-gpio = <0x3c 0x2c 0x00>;
				phandle = <0x640>;

				qcom,mdss-dsi-display-timings {

					timing@0 {
						qcom,mdss-dsi-cmd-mode;
						qcom,mdss-dsi-panel-framerate = <0x3c>;
						qcom,mdss-dsi-panel-width = <0x438>;
						qcom,mdss-dsi-panel-height = <0x960>;
						qcom,mdss-dsi-h-front-porch = <0x10>;
						qcom,mdss-dsi-h-back-porch = <0x08>;
						qcom,mdss-dsi-h-pulse-width = <0x08>;
						qcom,mdss-dsi-h-sync-skew = <0x00>;
						qcom,mdss-dsi-v-back-porch = <0x08>;
						qcom,mdss-dsi-v-front-porch = <0x4bc>;
						qcom,mdss-dsi-v-pulse-width = <0x04>;
						qcom,mdss-dsi-h-sync-pulse = <0x00>;
						qcom,mdss-dsi-h-left-border = <0x00>;
						qcom,mdss-dsi-h-right-border = <0x00>;
						qcom,mdss-dsi-v-top-border = <0x00>;
						qcom,mdss-dsi-v-bottom-border = <0x00>;
						qcom,mdss-dsi-panel-clockrate = <0x28a67e80>;
						qcom,mdss-dsi-panel-jitter = <0x05 0x01>;
						qcom,mdss-mdp-transfer-time-us = <0x251c>;
						qcom,mdss-dsi-on-command = [15 01 00 00 00 00 02 03 01 39 01 00 00 00 00 03 f0 aa 10 39 01 00 00 00 00 04 e7 00 40 00 39 01 00 00 00 00 06 cf 09 07 8b 89 13 39 01 00 00 00 00 08 b1 01 ec 00 18 04 e0 00 39 01 00 00 00 00 03 44 00 03 39 01 00 00 00 00 03 f0 aa 12 39 01 00 00 00 00 03 c1 00 0f 39 01 00 00 00 00 12 c3 c1 20 01 37 01 37 01 37 03 a5 03 a5 03 a5 20 00 63 39 01 00 00 00 00 11 c4 00 00 00 00 00 00 00 00 00 00 00 00 00 00 00 00 05 01 00 00 00 00 02 35 00 15 01 00 00 00 00 02 53 20 15 01 00 00 00 00 02 59 09 39 01 00 00 00 00 03 51 00 00 15 01 00 00 00 00 02 6c 00 15 01 00 00 00 00 02 6f 02 39 01 00 00 00 00 33 70 11 00 00 89 30 80 09 60 04 38 00 28 04 38 04 38 02 00 03 a3 00 20 04 72 00 0f 00 0f 03 14 01 46 18 00 10 f0 03 0c 20 00 06 0b 0b 33 0e 1c 2a 38 46 54 15 01 00 00 00 00 02 65 32 39 01 00 00 00 00 2d 70 62 69 70 77 79 7b 7d 7e 01 02 01 00 09 40 09 be 19 fc 19 fa 19 f8 1a 38 1a 78 1a b6 2a b6 2a f4 2a f4 4b 34 7b f4 00 00 00 00 00 00 39 01 00 00 00 00 03 f0 aa 14 39 01 00 00 00 00 03 b2 03 33 39 01 00 00 00 00 0d b4 0a 56 00 00 0a 56 00 00 0a 56 00 00 39 01 00 00 00 00 0a b5 00 17 17 17 17 17 17 06 01 39 01 00 00 00 00 07 b9 00 00 0a 17 17 17 39 01 00 00 00 00 0c bc 10 00 00 0a 11 17 69 17 69 17 69 39 01 00 00 00 00 0c be 10 10 00 0a 22 17 41 17 41 17 41 39 01 00 00 00 00 03 ff 5a 81 15 01 00 00 00 00 02 65 05 15 01 00 00 00 00 02 f3 0f 39 01 00 00 00 00 03 f0 aa 12 39 01 00 00 00 00 05 c7 2f 43 32 44 39 01 00 00 00 00 03 f0 aa 18 15 01 00 00 00 00 02 b0 13 15 01 00 00 00 00 02 b2 13 39 01 00 00 00 00 03 f0 aa 17 39 01 00 00 00 00 05 b1 00 00 12 00 39 01 00 00 00 00 17 b2 00 00 00 02 e0 00 0e 00 00 e0 00 00 00 00 20 20 00 40 00 00 20 20 39 01 00 00 00 00 13 b3 00 40 1a 00 3c 00 80 a8 98 80 a8 80 00 c0 00 00 1f a0 39 01 00 00 00 00 03 f0 aa 10 39 01 00 00 00 00 02 b3 c7 39 01 00 00 00 00 03 f0 aa 15 15 01 00 00 00 00 02 c3 01 39 01 00 00 00 00 09 d2 00 01 04 38 05 c9 0a 00 15 01 00 00 00 00 02 b1 65 39 01 00 00 00 00 07 b2 36 02 00 03 30 00 39 01 00 00 00 00 03 b3 26 41 39 01 00 00 00 00 07 b4 25 41 00 45 00 00 39 01 00 00 00 00 07 b5 25 41 00 45 00 00 39 01 00 00 00 00 07 b6 25 41 00 45 00 00 39 01 00 00 00 00 07 b7 25 41 00 45 00 00 39 01 00 00 00 00 07 b8 a4 00 00 25 00 00 39 01 00 00 00 00 03 bc 07 02 39 01 00 00 00 00 0c be 22 44 22 22 44 44 44 44 44 44 00 39 01 00 00 00 00 03 f0 aa 12 39 01 00 00 00 00 02 65 08 39 01 00 00 00 00 05 d2 10 00 01 01 39 01 00 00 00 00 03 f0 aa 00 39 01 00 00 00 00 03 ff 5a 00 05 01 00 00 c8 00 02 11 00 05 01 00 00 00 00 02 29 00];
						qcom,mdss-dsi-off-command = [05 01 00 00 14 00 02 28 00 05 01 00 00 78 00 02 10 00];
						qcom,mdss-dsi-on-command-state = "dsi_lp_mode";
						qcom,mdss-dsi-off-command-state = "dsi_lp_mode";
						qcom,mdss-dsi-timing-switch-command = [15 01 00 00 0c 00 02 6c 00];
						qcom,mdss-dsi-timing-switch-command-state = "dsi_lp_mode";
						qcom,mdss-dsi-nolp-command = [05 01 00 00 00 00 01 38 15 01 00 00 00 00 02 6c 00];
						qcom,mdss-dsi-nolp-command-state = "dsi_lp_mode";
						qcom,compression-mode = "dsc";
						qcom,mdss-dsc-version = <0x11>;
						qcom,mdss-dsc-scr-version = <0x00>;
						qcom,mdss-dsc-slice-height = <0x0c>;
						qcom,mdss-dsc-slice-width = <0x438>;
						qcom,mdss-dsc-slice-per-pkt = <0x01>;
						qcom,mdss-dsc-bit-per-component = <0x0a>;
						qcom,mdss-dsc-bit-per-pixel = <0x08>;
						qcom,mdss-dsc-block-prediction-enable;
						mi,mdss-dsc-panel-id = "\0K9D\0B\r";
						mi,mdss-dsi-dimmingon-command = [15 01 00 00 00 00 02 53 28];
						mi,mdss-dsi-dimmingon-command-state = "dsi_hs_mode";
						mi,mdss-dsi-dimmingoff-command = [15 01 00 00 00 00 02 53 20];
						mi,mdss-dsi-dimmingoff-command-state = "dsi_hs_mode";
						mi,mdss-dsi-hbm-on-command = [15 01 00 00 00 00 02 53 28 39 01 00 00 00 00 05 51 0f ff 00 00];
						mi,mdss-dsi-hbm-off-command = [15 01 00 00 00 00 02 53 28 39 01 00 00 00 00 05 51 07 ff 00 00];
						mi,mdss-dsi-hbm-on-command-state = "dsi_lp_mode";
						mi,mdss-dsi-hbm-off-command-state = "dsi_lp_mode";
						mi,mdss-dsi-doze-hbm-command = [05 01 00 00 14 00 01 39 15 01 00 00 00 00 02 6d 00];
						mi,mdss-dsi-doze-lbm-command = [05 01 00 00 14 00 01 39 15 01 00 00 00 00 02 6d 01];
						mi,mdss-dsi-doze-hbm-command-state = "dsi_lp_mode";
						mi,mdss-dsi-doze-lbm-command-state = "dsi_lp_mode";
						qcom,mdss-dsi-panel-phy-timings = [00 18 06 06 21 20 06 06 04 02 04 00 15 16];
						qcom,display-topology = <0x01 0x01 0x01>;
						qcom,default-topology-index = <0x00>;
					};

					timing@1 {
						qcom,mdss-dsi-cmd-mode;
						qcom,mdss-dsi-panel-framerate = <0x5a>;
						qcom,mdss-dsi-panel-width = <0x438>;
						qcom,mdss-dsi-panel-height = <0x960>;
						qcom,mdss-dsi-h-front-porch = <0x10>;
						qcom,mdss-dsi-h-back-porch = <0x08>;
						qcom,mdss-dsi-h-pulse-width = <0x08>;
						qcom,mdss-dsi-h-sync-skew = <0x00>;
						qcom,mdss-dsi-v-back-porch = <0x08>;
						qcom,mdss-dsi-v-front-porch = <0x04>;
						qcom,mdss-dsi-v-pulse-width = <0x04>;
						qcom,mdss-dsi-h-sync-pulse = <0x00>;
						qcom,mdss-dsi-h-left-border = <0x00>;
						qcom,mdss-dsi-h-right-border = <0x00>;
						qcom,mdss-dsi-v-top-border = <0x00>;
						qcom,mdss-dsi-v-bottom-border = <0x00>;
						qcom,mdss-dsi-panel-clockrate = <0x28a67e80>;
						qcom,mdss-dsi-panel-jitter = <0x05 0x01>;
						qcom,mdss-mdp-transfer-time-us = <0x251c>;
						qcom,mdss-dsi-on-command = <0x15010000 0x203 0x1390100 0x03 0xf0aa1039 0x1000000 0x4e700 0x40003901 0x00 0x6cf0907 0x8b891339 0x1000000 0x8b101 0xec001804 0xe0003901 0x00 0x3440003 0x39010000 0x3f0 0xaa123901 0x00 0x3c1000f 0x39010000 0x12c3 0xc1200137 0x1370137 0x3a503a5 0x3a52000 0x63390100 0x11 0xc4000000 0x00 0x00 0x00 0x50100 0x02 0x35001501 0x00 0x2532015 0x1000000 0x25909 0x39010000 0x351 0x1501 0x00 0x26c0115 0x1000000 0x26f02 0x39010000 0x3f0 0xaa143901 0x00 0x3b20333 0x39010000 0xdb4 0xa560000 0xa560000 0xa560000 0x39010000 0xab5 0x171717 0x17171706 0x1390100 0x07 0xb900000a 0x17171739 0x1000000 0xcbc10 0xa11 0x17691769 0x17693901 0x00 0xcbe1010 0xa2217 0x41174117 0x41390100 0x03 0xff5a8115 0x1000000 0x26505 0x15010000 0x2f3 0xf390100 0x03 0xf0aa1239 0x1000000 0x5c72f 0x43324439 0x1000000 0x3f0aa 0x18150100 0x02 0xb0131501 0x00 0x2b21339 0x1000000 0x3f0aa 0x17390100 0x05 0xb1000012 0x390100 0x17 0xb2000000 0x2e0000e 0xe000 0x20 0x20004000 0x202039 0x1000000 0x13b300 0x401a003c 0x80a898 0x80a88000 0xc000001f 0xa0390100 0x03 0xf0aa1039 0x1000000 0x2b3c7 0x39010000 0x3f0 0xaa151501 0x00 0x2c30139 0x1000000 0x9d200 0x1043805 0xc90a0015 0x1000000 0x2b165 0x39010000 0x7b2 0x36020003 0x30003901 0x00 0x3b32641 0x39010000 0x7b4 0x25410045 0x3901 0x00 0x7b52541 0x450000 0x39010000 0x7b6 0x25410045 0x3901 0x00 0x7b72541 0x450000 0x39010000 0x7b8 0xa4000025 0x3901 0x00 0x3bc0702 0x39010000 0xcbe 0x22442222 0x44444444 0x44440039 0x1000000 0x3f0aa 0x12390100 0x02 0x65083901 0x00 0x5d21000 0x1013901 0x00 0x3f0aa00 0x39010000 0x3ff 0x5a000501 0xc800 0x2110005 0x1000000 0x22900>;
						qcom,mdss-dsi-off-command = [05 01 00 00 14 00 02 28 00 05 01 00 00 78 00 02 10 00];
						qcom,mdss-dsi-on-command-state = "dsi_lp_mode";
						qcom,mdss-dsi-off-command-state = "dsi_lp_mode";
						qcom,mdss-dsi-timing-switch-command = [15 01 00 00 0c 00 02 6c 01];
						qcom,mdss-dsi-timing-switch-command-state = "dsi_lp_mode";
						qcom,mdss-dsi-nolp-command = [05 01 00 00 00 00 01 38 15 01 00 00 00 00 02 6c 01];
						qcom,mdss-dsi-nolp-command-state = "dsi_lp_mode";
						qcom,compression-mode = "dsc";
						qcom,mdss-dsc-version = <0x11>;
						qcom,mdss-dsc-scr-version = <0x00>;
						qcom,mdss-dsc-slice-height = <0x0c>;
						qcom,mdss-dsc-slice-width = <0x438>;
						qcom,mdss-dsc-slice-per-pkt = <0x01>;
						qcom,mdss-dsc-bit-per-component = <0x0a>;
						qcom,mdss-dsc-bit-per-pixel = <0x08>;
						qcom,mdss-dsc-block-prediction-enable;
						mi,mdss-dsc-panel-id = "\0K9D\0B\r";
						mi,mdss-dsi-dimmingon-command = [15 01 00 00 00 00 02 53 28];
						mi,mdss-dsi-dimmingon-command-state = "dsi_hs_mode";
						mi,mdss-dsi-dimmingoff-command = [15 01 00 00 00 00 02 53 20];
						mi,mdss-dsi-dimmingoff-command-state = "dsi_hs_mode";
						mi,mdss-dsi-hbm-on-command = [15 01 00 00 00 00 02 53 28 39 01 00 00 00 00 05 51 0f ff 00 00];
						mi,mdss-dsi-hbm-off-command = [15 01 00 00 00 00 02 53 28 39 01 00 00 00 00 05 51 07 ff 00 00];
						mi,mdss-dsi-hbm-on-command-state = "dsi_lp_mode";
						mi,mdss-dsi-hbm-off-command-state = "dsi_lp_mode";
						mi,mdss-dsi-doze-hbm-command = [15 01 00 00 11 00 02 6c 00 05 01 00 00 14 00 01 39 15 01 00 00 00 00 02 6d 00];
						mi,mdss-dsi-doze-lbm-command = [15 01 00 00 11 00 02 6c 00 05 01 00 00 14 00 01 39 15 01 00 00 00 00 02 6d 01];
						mi,mdss-dsi-doze-hbm-command-state = "dsi_lp_mode";
						mi,mdss-dsi-doze-lbm-command-state = "dsi_lp_mode";
						qcom,mdss-dsi-panel-phy-timings = [00 18 06 06 21 20 06 06 04 02 04 00 15 16];
						qcom,display-topology = <0x01 0x01 0x01>;
						qcom,default-topology-index = <0x00>;
					};
				};
			};
